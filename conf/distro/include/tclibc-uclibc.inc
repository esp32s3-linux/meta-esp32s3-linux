## conf/distro/include/tclibc-uclibc.inc
```bitbake
# SPDX-License-Identifier: MIT

LIBCEXTENSION = "-uclibc"
LIBCOVERRIDE = ":libc-uclibc"

PREFERRED_PROVIDER_virtual/libc = "external-xtensa-esp32s3-toolchain"
PREFERRED_PROVIDER_virtual/libc-locale = "external-xtensa-esp32s3-toolchain"
PREFERRED_PROVIDER_virtual/libiconv = "external-xtensa-esp32s3-toolchain"
PREFERRED_PROVIDER_virtual/libintl = "gettext"
PREFERRED_PROVIDER_virtual/crypt = "external-xtensa-esp32s3-toolchain"

LIBC_DEPENDENCIES = "external-xtensa-esp32s3-toolchain"
DISTRO_FEATURES_OPTED_OUT += "ldconfig"
```

## conf/machine/esp32s3-devkitc-1-n16r8.conf
```bitbake
# SPDX-License-Identifier: MIT

require conf/machine/include/tune-xtensa-esp32s3-fdpic.inc

MACHINEOVERRIDES =. "esp32s3:esp32s3-devkitc-1-n16r8:"

MACHINE_FEATURES = ""
MACHINE_ESSENTIAL_EXTRA_RDEPENDS = "kernel-image-xipimage"

KERNEL_IMAGETYPE = "xipImage"
KERNEL_IMAGE_LINK_NAME = ""
KERNEL_IMAGETYPE_SYMLINK = "1"

IMAGE_FSTYPES = "cramfs"
IMAGE_FEATURES = ""
EXTRA_IMAGE_FEATURES = ""

SERIAL_CONSOLES = "115200;ttyS0"

ESP32S3_FLASH_SIZE = "16MB"
ESP32S3_PSRAM_SIZE = "8MB"
ESP32S3_ESP_HOSTED_SDKCONFIG = "sdkconfig.defaults.esp32s3.16n16r"
ESP32S3_PARTITION_TABLE = "partition_table.esp32s3.16m"
ESP32S3_PARTITION_TABLE_FILE = "partition-table-n16r8.csv"

TCMODE = "external-xtensa-esp32s3-fdpic"
PREFERRED_PROVIDER_virtual/kernel = "linux-xtensa"
```

## conf/machine/include/tune-xtensa-esp32s3-fdpic.inc
```bitbake
# SPDX-License-Identifier: MIT

DEFAULTTUNE ?= "xtensa-esp32s3-fdpic"

TUNEVALID[xtensa] = "Xtensa architecture"
TUNEVALID[call0] = "Xtensa call0 ABI"
TUNEVALID[fdpic] = "FDPIC executable ABI"
TUNEVALID[nommu] = "No MMU"

AVAILTUNES += "xtensa-esp32s3-fdpic"
TUNE_FEATURES:tune-xtensa-esp32s3-fdpic = "xtensa call0 fdpic nommu"
TUNE_ARCH = "xtensa"
TUNE_PKGARCH = "xtensa-call0-fdpic"
PACKAGE_EXTRA_ARCHS:tune-xtensa-esp32s3-fdpic = "${TUNE_PKGARCH}"

MACHINEOVERRIDES =. "xtensa:xtensa-call0-fdpic:"
```
